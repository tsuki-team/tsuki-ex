## firmware/sdkconfig.defaults
```kconfig
# tsuki-ex sdkconfig defaults
# These are the base ESP-IDF config options for all tsuki-ex firmware builds.
# Feature-specific options (BT, WiFi) are added at compile time by Cargo features.

# ── CPU / Performance ─────────────────────────────────────────────────────────
CONFIG_ESP32_DEFAULT_CPU_FREQ_MHZ=80
CONFIG_ESP32_REV_MIN_FULL=0

# ── Power management ──────────────────────────────────────────────────────────
CONFIG_PM_ENABLE=y
CONFIG_FREERTOS_USE_TICKLESS_IDLE=y
CONFIG_FREERTOS_IDLE_TIME_BEFORE_SLEEP=3

# ── Logging ───────────────────────────────────────────────────────────────────
CONFIG_LOG_DEFAULT_LEVEL_INFO=y
CONFIG_LOG_MAXIMUM_LEVEL_INFO=y

# ── FreeRTOS ──────────────────────────────────────────────────────────────────
CONFIG_FREERTOS_HZ=100
CONFIG_FREERTOS_THREAD_LOCAL_STORAGE_POINTERS=2

# ── Flash filesystem (SPIFFS) ─────────────────────────────────────────────────
CONFIG_SPIFFS_USE_MAGIC=y
CONFIG_SPIFFS_USE_MAGIC_LENGTH=y
CONFIG_SPIFFS_META_LENGTH=4
CONFIG_SPIFFS_USE_MTIME=y

# ── Bluetooth (enabled when feature = bluetooth/ble) ──────────────────────────
# Controlled via Cargo features — leave disabled by default
# CONFIG_BT_ENABLED=y
# CONFIG_BTDM_CTRL_MODE_BLE_ONLY=y

# ── WiFi (enabled when feature = wifi) ───────────────────────────────────────
# Also controlled via Cargo features
# CONFIG_ESP_WIFI_ENABLED=y

# ── Misc ──────────────────────────────────────────────────────────────────────
CONFIG_COMPILER_OPTIMIZATION_SIZE=y
CONFIG_ESP_MAIN_TASK_STACK_SIZE=8192
CONFIG_ESPTOOLPY_FLASHSIZE_4MB=y
CONFIG_ESPTOOLPY_AFTER_RESET=y
```
